## sdkconfig.defaults
```kconfig
CONFIG_ESP_WIFI_SSID=""
CONFIG_ESP_WIFI_PASSWORD=""
CONFIG_MICRO_ROS_AGENT_IP=""

CONFIG_MICRO_ROS_ESP_XRCE_DDS_MIDDLEWARE=y
CONFIG_MICRO_ROS_ESP_NETIF_WLAN=y

CONFIG_SPIRAM=y
CONFIG_SPIRAM_TRY_ALLOCATE_WIFI_LWIP=y


CONFIG_SPIFFS_MAX_PARTITIONS=3
CONFIG_VFS_SUPPORT_IO=y
CONFIG_PARTITION_TABLE_CUSTOM=y
```
